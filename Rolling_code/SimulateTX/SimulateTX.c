/*
 * SimulateTX.c
 *
 * Created: 4/29/2021 2:56:45 PM
 *  Author: Welcome
 */ 
// Code for Transmitter Model: FS1000A, Transmitting Frequency: 433.92MHz
#ifndef F_CPU
//define CPU clock speed if not defined
#define F_CPU 8000000UL // AVR ATMega328P 16MHz
#endif

#include <avr/io.h> // enable data flow control over pins
#include <util/delay.h> // enable delay function in program
#include <avr/interrupt.h>
#include <avr/sleep.h>
#include <avr/sfr_defs.h>
//#include <avr/eeprom.h>


//set desired baud rate

#define BAUD 1200
#define MYUBRR F_CPU/16UL/BAUD-1

//define communicate parameters
#define SYNC 0xAA			// synchronization signal
#define RADDR 0x44			// receiver address
//#define KEY_ADDRESS 0x00FF	// key address		

#define CMD1 0x20//  up  command
#define CMD2 0x22// stop command
#define CMD3 0x24// down command

#define BUTTON1 5 // button switch connected to port C pin 5
#define BUTTON2 4 // button switch connected to port C pin 4
#define BUTTON3 3 // button switch connected to port C pin 3
#define MODULE  0 // power supply pin for module

#define DEBOUNCE_TIME 15 // time to wait while "de-bouncing" button
#define LOCK_INPUT_TIME 100 // time to wait after a button press

volatile uint8_t button_flag = 0;
volatile uint8_t button_flag1 = 0;

uint16_t count_number;


struct KEY_PACK {
	uint8_t count1,count2,y_box1,y_box2;
	};

typedef struct KEY_PACK Key_type;
Key_type encrypt_key;

uint8_t a[256]={
	//0     1    2      3     4    5     6     7      8    9     A      B    C     D     E     F
	0x63, 0x7c, 0x77, 0x7b, 0xf2, 0x6b, 0x6f, 0xc5, 0x30, 0x01, 0x67, 0x2b, 0xfe, 0xd7, 0xab, 0x76,
	0xca, 0x82, 0xc9, 0x7d, 0xfa, 0x59, 0x47, 0xf0, 0xad, 0xd4, 0xa2, 0xaf, 0x9c, 0xa4, 0x72, 0xc0,
	0xb7, 0xfd, 0x93, 0x26, 0x36, 0x3f, 0xf7, 0xcc, 0x34, 0xa5, 0xe5, 0xf1, 0x71, 0xd8, 0x31, 0x15,
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	0x8c, 0xa1, 0x89, 0x0d, 0xbf, 0xe6, 0x42, 0x68, 0x41, 0x99, 0x2d, 0x0f, 0xb0, 0x54, 0xbb, 0x16 };

uint8_t b[256]={
	//0     1    2      3     4    5     6     7      8    9     A      B    C     D     E     F
	0x63, 0x7c, 0x77, 0x7b, 0xf2, 0x6b, 0x6f, 0xc5, 0x30, 0x01, 0x67, 0x2b, 0xfe, 0xd7, 0xab, 0x76,
	0xca, 0x82, 0xc9, 0x7d, 0xfa, 0x86, 0x59, 0x47, 0xf0, 0xad, 0xd4, 0xa2, 0xaf, 0x9c, 0xa4, 0x72,
	0xb7, 0xfd, 0x93, 0x26, 0x36, 0x3f, 0xd9, 0xea, 0xf7, 0xcc, 0x34, 0xa5, 0xe5, 0xf1, 0x71, 0xd8,
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	0x8c, 0xa1, 0x89, 0x0d, 0xbf, 0xe6, 0x42, 0x41, 0x99, 0x2d, 0x0f, 0xb0, 0x54, 0xbb, 0x16, 0x07 };

Key_type encrypt(uint16_t count_temp){// count is the counter to sync
	Key_type key;
	key.count1=(count_temp&0xff00)>>8;
	key.count2= count_temp&0x00ff    ;
	key.y_box1=a[key.count1];			//Transmitter
	key.y_box1=a[key.y_box1];
	key.y_box2=b[key.count2];			//Transmitter
	key.y_box2=b[key.y_box2];
	return key;
}

// Initializing UART
void usart_init(unsigned int ubrr)
{
	//set baudrate
	UBRR0H = (unsigned char)(ubrr>>8);
	UBRR0L = (unsigned char)ubrr;
	//enable receiver & transmitter
	UCSR0B = (1<<RXEN0)|(1<<TXEN0);
	//set frame 8N1
	UCSR0C = (0<<UMSEL01)|(0<<UMSEL00)|(0<<UPM01)|(0<<UPM00)|(0<<USBS0)|(0<<UCSZ02)|(1<<UCSZ01)|(1<<UCSZ00);
}

// Transmit data(byte) function
void USART_vSendByte(uint8_t u8Data){
	// Wait for transmit buffer to be empty
	while(!(UCSR0A&(1<<UDRE0)));
	// Transmit data - load data into transmit register
	UDR0 = u8Data;
}

// Send packet of data
void Send_Packet(uint8_t addr, uint8_t cmd, Key_type key)
{	
	for(int i=0;i<5;i++)
	{
		USART_vSendByte(SYNC);//send synchronization byte
		USART_vSendByte(addr);//send receiver address
		USART_vSendByte((key.count1&0xf0)+(key.y_box1&0x0f));
		USART_vSendByte((key.count1&0x0f)+(key.y_box1&0xf0));
		USART_vSendByte((key.count2&0xf0)+(key.y_box2&0x0f));
		USART_vSendByte((key.count2&0x0f)+(key.y_box2&0xf0));
		USART_vSendByte(cmd);//send increment command
		USART_vSendByte((addr+key.count1+key.y_box1+key.count2+key.y_box2+cmd)&0x00FF);//send checksum
	}
	
}

// Main initialization
void Main_Init(void)
{
	DDRB |= (1<<MODULE);
	PORTC = 0x00;
	//count_number=eeprom_read_word((uint16_t*)KEY_ADDRESS);
	count_number=0;
}

void extint_init(void){
	EICRA |= (1<<ISC00)|(1<<ISC10)|(1<<ISC11);
	EIMSK |= (1<<INT0)|(1<<INT1) ;
}

/*void sleep_init(void)
{
	set_sleep_mode(SLEEP_MODE_PWR_DOWN);
	sleep_enable();
	cli();
}*/

int main(void)
{
	usart_init(MYUBRR);
	Main_Init();
	extint_init();
	//sleep_init();
	while(1)
	{
		if(button_flag == 1){
			if (bit_is_set(PINC,BUTTON1))// the button is pressed when BUTTON bit is clear
			{	PORTB |= (1<<MODULE);
				Send_Packet(RADDR, CMD1,encrypt_key);// check the state of the button again
				_delay_ms(LOCK_INPUT_TIME);button_flag1 = 1;}
			
			else if (bit_is_set(PINC,BUTTON2))// the button is pressed when BUTTON bit is clear
			{	PORTB |= (1<<MODULE);
				Send_Packet(RADDR, CMD2,encrypt_key);
				_delay_ms(LOCK_INPUT_TIME);	button_flag1 = 1;}
			
			else if (bit_is_set(PINC,BUTTON3))// the button is pressed when BUTTON bit is clear
			{	PORTB |= (1<<MODULE);
				Send_Packet(RADDR, CMD3,encrypt_key);
				_delay_ms(LOCK_INPUT_TIME);	button_flag1 = 1;}
			
			PORTB &= ~(1<<MODULE);
		}
		else{
			cli();
			button_flag1=0;
			//eeprom_write_word((uint16_t*)KEY_ADDRESS,count_number);
			//sleep_enable();
			cli();
			//sleep_bod_disable();
			sei();
			//sleep_cpu();
			//sleep_disable();
		}
	}
	return 0;
}

ISR(INT0_vect){
	if(button_flag1) {button_flag = 0;count_number++;} 
	else             {button_flag = 1;
				      encrypt_key=encrypt(count_number);
					  _delay_ms(DEBOUNCE_TIME);}
}

ISR(INT1_vect){
	count_number = 150;
	PORTB |=(1<<MODULE);
	for (int i=0;i<30000;i++);
	PORTB&=~(1<<MODULE);
}